#include "U8glib.h"
#include "EncoderStepCounter.h"
#include <Bounce2.h>

// Pins for Creality Melzi / Your specific setup
#define ENCODER_PIN1 10
#define ENCODER_PIN2 11
const int buttonPin = 16; 
const int beeperPin = 27;
const int led = 20; // Pin from your image

// Software SPI Constructor
U8GLIB_ST7920_128X64_4X u8g(30, 17, 28); 

EncoderStepCounter encoder(ENCODER_PIN1, ENCODER_PIN2);
Bounce debouncer = Bounce();

// --- LOGO BITMAP ---
const unsigned char epd_bitmap_QAMT_Fixed [] PROGMEM = {
  0x00, 0x00, 0x00, 0x00, 0x00, 0x00, 0x00, 0x00, 0x00, 0x00, 0x00, 0x00, 0x00, 0x00, 0x00, 0x00,
  0x00, 0x00, 0x00, 0x00, 0x00, 0x00, 0x00, 0x00, 0x00, 0x00, 0x00, 0x00, 0x00, 0x00, 0x00, 0x00,
  0x00, 0x00, 0x00, 0x00, 0x00, 0x00, 0x00, 0x00, 0x00, 0x00, 0x00, 0x00, 0x00, 0x00, 0x00, 0x00,
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  0x00, 0x00, 0x00, 0x00, 0x00, 0x00, 0x00, 0x00, 0x00, 0x00, 0x00, 0x00, 0x00, 0x00, 0x00, 0x00
};
// Menu State
int currentMenu = 0; 
int menu_current = 0;
int selectedOption = 0; 
const char *main_menu[] = { "Flash LED", "Option 2", "Option 3", "Option 4" };

// Variables for Non-Blocking Blink (Replacing delay(1000))
unsigned long lastBlink = 0;
bool ledState = LOW;

void interrupt() {
  encoder.tick();
}

void setup() {
  pinMode(beeperPin, OUTPUT);
  pinMode(led, OUTPUT); // Initialize pin 20 as output
  debouncer.attach(buttonPin, INPUT_PULLUP);
  debouncer.interval(5); 

  encoder.begin();
  attachInterrupt(digitalPinToInterrupt(ENCODER_PIN1), interrupt, CHANGE);
  attachInterrupt(digitalPinToInterrupt(ENCODER_PIN2), interrupt, CHANGE);

  // Show Logo
  u8g.firstPage();
  do {
    u8g.drawBitmapP(0, 0, 16, 64, epd_bitmap_QAMT_Fixed);
  } while( u8g.nextPage() );
  delay(3000); 
}

void draw_screen() {
  u8g.setFont(u8g_font_6x13);
  u8g.setFontPosTop();
  uint8_t h = 15; 
  uint8_t w = u8g.getWidth();

  if (currentMenu == 0) {
    for (int i = 0; i < 4; i++) {
      if (i == menu_current) {
        u8g.drawBox(0, i * h, w, h);
        u8g.setDefaultBackgroundColor();
      }
      u8g.drawStr(5, i * h, main_menu[i]);
      u8g.setDefaultForegroundColor();
    }
  } else {
    u8g.drawStr(5, 0, "Active:");
    u8g.drawStr(50, 20, main_menu[selectedOption]);
    u8g.drawBox(0, 45, w, 15);
    u8g.setDefaultBackgroundColor();
    u8g.drawStr(5, 45, "< BACK");
    u8g.setDefaultForegroundColor();
  }
}

void loop() {
  debouncer.update();

  // 1. Navigation
  signed char pos = encoder.getPosition();
  if (pos != 0) {
    if (currentMenu == 0) {
      menu_current += pos;
      if (menu_current < 0) menu_current = 0;
      if (menu_current > 3) menu_current = 3;
    }
    encoder.reset();
  }

  // 2. Selection Logic
  if (debouncer.fell()) {
    digitalWrite(beeperPin, HIGH);
    delay(40); 
    digitalWrite(beeperPin, LOW);

    if (currentMenu == 0) {
      selectedOption = menu_current;
      currentMenu = 1; 
    } else {
      currentMenu = 0; 
      digitalWrite(led, LOW); // Ensure LED turns off when going back
    }
  }

  // 3. THE BLINK LOGIC (Replaces your image's loop code)
  if (currentMenu == 1 && selectedOption == 0) {
    // Instead of delay(1000), we check if 1 second has passed
    if (millis() - lastBlink >= 1000) {
      lastBlink = millis();
      ledState = !ledState;
      digitalWrite(led, ledState);
    }
  }

  // 4. Picture Loop
  u8g.firstPage();  
  do {
    draw_screen();
  } while(u8g.nextPage());
}